## main/Kconfig.projbuild
```kconfig
menu "IR Remote Config"
config IR_TX_GPIO
    int "Infrared TX GPIO number"
    default 4
    range 0 39
    help
        GPIO number connected to the IR transmitter DAT pin.
config IR_CARRIER_HZ
    int "IR carrier frequency (Hz)"
    default 38000
    range 1000 100000
    help
        Infrared carrier frequency for the NEC transmitter (38 kHz typical).
config ONE_KEY_BTN_GPIO
    int "One-key macro button GPIO number (active-low)"
    default 5
    range 0 39
    help
        GPIO connected to a physical button shorting it to GND (internal
        pull-up enabled); a press is a LOW level. Each debounced press plays
        the macro bound as the "one-key macro" in the web UI. Must differ from
        IR TX GPIO (init refuses the collision).
config AP_SSID
    string "SoftAP SSID"
    default "esp32-ir"
config AP_PASSWORD
    string "SoftAP Password (empty = open)"
    default ""
endmenu
```

## sdkconfig.defaults
```kconfig
CONFIG_COMPILER_OPTIMIZATION_SIZE=y
CONFIG_COMPILER_CXX_EXCEPTIONS=n
CONFIG_ESP_MAIN_TASK_STACK_SIZE=8192
CONFIG_HTTPD_MAX_REQ_HDR_LEN=2048
CONFIG_HTTPD_MAX_URI_LEN=2048
CONFIG_ESPTOOLPY_FLASHSIZE_16MB=y
CONFIG_PARTITION_TABLE_CUSTOM=y
CONFIG_PARTITION_TABLE_CUSTOM_FILENAME="partitions/4m.csv"
CONFIG_PARTITION_TABLE_OFFSET=0x8000
CONFIG_ESP_TASK_WDT_TIMEOUT_S=20
```
